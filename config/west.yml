## config/west.yml
```yaml
manifest:
    defaults:
        revision: v0.3
    remotes:
        - name: zmkfirmware
          url-base: https://github.com/zmkfirmware
        - name: kevinpastor
          url-base: https://github.com/kevinpastor
    projects:
        - name: zmk
          remote: zmkfirmware
          import: app/west.yml
        - name: nice-view-elemental
          remote: kevinpastor
          revision: main
    self:
        path: config
```
